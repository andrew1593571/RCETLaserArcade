;************************************************************************************
;										    *
;   Filename:	    MASTER_SUBROUTINES.inc					    *
;   Date:	    April 22, 2025						    *
;   File Version:   2								    *
;   Author:	    Alex Wheelock and Andrew Keller				    *
;   Company:	    Idaho State University					    *
;   Description:    Contains all subroutines needed for the Laser Shooting Game     *
;		    project. Subroutines include the ability to communicate via	    *
;		    UART for control, I2C write/read, and updating each target	    *
;		    slot for I2C enabling, disabling or polling.		    *
;										    *
;************************************************************************************

;************************************************************************************
;										    *
;   Revision History:								    *
;										    *
;   1:	Initialize file, get everything working the way that I thought it should    *
;	work.									    *
;   2:	Update to include UART and I2C for up to eight different targets active     *
;	simultaneously.								    *
;										    *
;************************************************************************************		
	    
//SUBROUTINES_CODE CODE
  PSECT code
    ;WRITES THE DATA STORED IN WRITE_DATA TO THE I2C ADDRESS IN CURRENT_ADDRESS
    WRITE_I2C:
	    CALL	    I2CIDLE		;ENSURE THAT THE I2C LINES ARE IDLE
	    BANKSEL	    SSP1CON2
	    BSF		    SSP1CON2,0
	    BTFSC	    SSP1CON2,0		;WAIT UNTIL START CONDITION IS COMPLETE
	    GOTO	    $-1
	    BANKSEL	    PORTA
	    MOVF	    CURRENT_ADDRESS, 0	;SEND I2C ADDRESS OUT
	    BANKSEL	    SSP1BUF
	    MOVWF	    SSP1BUF
	    BANKSEL	    SSP1STAT
	    BTFSC	    SSP1STAT,0		;WAIT UNTIL ALL DATA HAS BEEN SHIFTED OUT OF SSPBUF
	    GOTO	    $-1
	    CALL	    I2CIDLE		;ENSURE THAT THE I2C LINES ARE IDLE
	    BANKSEL	    SSP1CON2
	    BTFSC	    SSP1CON2,6		;DETERMINE IF THERE IS AN ACK FROM THE SLAVE
	    GOTO	    BAD1		;NACK FROM THE SLAVE, STOP COMMUNICATION
	    BANKSEL	    PORTA
	    MOVF	    WRITE_DATA, W
	    BANKSEL	    SSP1BUF
	    MOVWF	    SSP1BUF		;TRANSMIT DATA TO SLAVE
	    BANKSEL	    SSP1STAT
	    BTFSC	    SSP1STAT,0		;WAIT UNTIL ALL DATA HAS BEEN SHIFTED OUT OF SSPBUF
	    GOTO	    $-1
	    CALL	    I2CIDLE		;ENSURE THAT THE I2C LINES ARE IDLE
	    BANKSEL	    SSP1CON2
	    BTFSC	    SSP1CON2,6		;DETERMINE IF THERE IS AN ACK FROM THE SLAVE
	    GOTO	    BAD1		;NACK FROM THE SLAVE, STOP COMMUNICATION
	    BSF		    SSP1CON2,2		;CREATE STOP CONDITION
	    BTFSC	    SSP1CON2,2
	    GOTO	    $-1			;WAIT FOR STOP CONDITION TO COMPLETE
	    
	    BANKSEL	    TX1REG
	    BTFSS	    TRMT
	    GOTO	    $-1
	    MOVLW	    0x24 ;SENDS THE DOLLAR HANDSHAKE
	    MOVWF	    TX1REG

	    BTFSS	    TRMT
	    GOTO	    $-1
	    MOVLW	    0x41 ;A
	    MOVWF	    TX1REG

	    BANKSEL	    PORTA
	    RETURN
	    
    ;WRITES THE DATA STORED IN WRITE_DATA TO THE I2C ADDRESS IN CURRENT_ADDRESS
    WRITE_COLOR_I2C:
	    CALL	    I2CIDLE		;ENSURE THAT THE I2C LINES ARE IDLE
	    BANKSEL	    SSP1CON2
	    BSF		    SSP1CON2,0
	    BTFSC	    SSP1CON2,0		;WAIT UNTIL START CONDITION IS COMPLETE
	    GOTO	    $-1
	    BANKSEL	    PORTA
	    MOVLW	    0x00		;SEND I2C ADDRESS OUT 
	    BANKSEL	    SSP1BUF
	    MOVWF	    SSP1BUF
	    BANKSEL	    SSP1STAT
	    BTFSC	    SSP1STAT,0		;WAIT UNTIL ALL DATA HAS BEEN SHIFTED OUT OF SSPBUF
	    GOTO	    $-1
	    CALL	    I2CIDLE		;ENSURE THAT THE I2C LINES ARE IDLE
	    BANKSEL	    SSP1CON2
	    BTFSC	    SSP1CON2,6		;DETERMINE IF THERE IS AN ACK FROM THE SLAVE
	    GOTO	    BAD1		;NACK FROM THE SLAVE, STOP COMMUNICATION
	    BANKSEL	    PORTA
	    MOVLW	    0x43
	    BANKSEL	    SSP1BUF
	    MOVWF	    SSP1BUF		;TRANSMIT DATA TO SLAVE
	    BANKSEL	    SSP1STAT
	    BTFSC	    SSP1STAT,0		;WAIT UNTIL ALL DATA HAS BEEN SHIFTED OUT OF SSPBUF
	    GOTO	    $-1
	    CALL	    I2CIDLE		;ENSURE THAT THE I2C LINES ARE IDLE
	    BANKSEL	    SSP1CON2
	    BTFSC	    SSP1CON2,6		;DETERMINE IF THERE IS AN ACK FROM THE SLAVE
	    GOTO	    BAD1		;NACK FROM THE SLAVE, STOP COMMUNICATION
	    BANKSEL	    PORTA
	    MOVF	    PLAYER_NUMBER, W
	    BANKSEL	    SSP1BUF
	    MOVWF	    SSP1BUF		;TRANSMIT DATA TO SLAVE
	    BANKSEL	    SSP1STAT
	    BTFSC	    SSP1STAT,0		;WAIT UNTIL ALL DATA HAS BEEN SHIFTED OUT OF SSPBUF
	    GOTO	    $-1
	    CALL	    I2CIDLE		;ENSURE THAT THE I2C LINES ARE IDLE
	    BANKSEL	    SSP1CON2
	    BTFSC	    SSP1CON2,6		;DETERMINE IF THERE IS AN ACK FROM THE SLAVE
	    GOTO	    BAD1		;NACK FROM THE SLAVE, STOP COMMUNICATION
	    BANKSEL	    PORTA
	    MOVF	    GREEN, W
	    BANKSEL	    SSP1BUF
	    MOVWF	    SSP1BUF		;TRANSMIT DATA TO SLAVE
	    BANKSEL	    SSP1STAT
	    BTFSC	    SSP1STAT,0		;WAIT UNTIL ALL DATA HAS BEEN SHIFTED OUT OF SSPBUF
	    GOTO	    $-1
	    CALL	    I2CIDLE		;ENSURE THAT THE I2C LINES ARE IDLE
	    BANKSEL	    SSP1CON2
	    BTFSC	    SSP1CON2,6		;DETERMINE IF THERE IS AN ACK FROM THE SLAVE
	    GOTO	    BAD1		;NACK FROM THE SLAVE, STOP COMMUNICATION
	    BANKSEL	    PORTA
	    MOVF	    RED, W
	    BANKSEL	    SSP1BUF
	    MOVWF	    SSP1BUF		;TRANSMIT DATA TO SLAVE
	    BANKSEL	    SSP1STAT
	    BTFSC	    SSP1STAT,0		;WAIT UNTIL ALL DATA HAS BEEN SHIFTED OUT OF SSPBUF
	    GOTO	    $-1
	    CALL	    I2CIDLE		;ENSURE THAT THE I2C LINES ARE IDLE
	    BANKSEL	    SSP1CON2
	    BTFSC	    SSP1CON2,6		;DETERMINE IF THERE IS AN ACK FROM THE SLAVE
	    GOTO	    BAD1		;NACK FROM THE SLAVE, STOP COMMUNICATION
	    BANKSEL	    PORTA
	    MOVF	    BLUE, W
	    BANKSEL	    SSP1BUF
	    MOVWF	    SSP1BUF		;TRANSMIT DATA TO SLAVE
	    BANKSEL	    SSP1STAT
	    BTFSC	    SSP1STAT,0		;WAIT UNTIL ALL DATA HAS BEEN SHIFTED OUT OF SSPBUF
	    GOTO	    $-1
	    CALL	    I2CIDLE		;ENSURE THAT THE I2C LINES ARE IDLE
	    BANKSEL	    SSP1CON2
	    BTFSC	    SSP1CON2,6		;DETERMINE IF THERE IS AN ACK FROM THE SLAVE
	    GOTO	    BAD1		;NACK FROM THE SLAVE, STOP COMMUNICATION
	    BSF		    SSP1CON2,2		;CREATE STOP CONDITION
	    BTFSC	    SSP1CON2,2
	    GOTO	    $-1			;WAIT FOR STOP CONDITION TO COMPLETE
	    
	    BANKSEL	    TX1REG
	    BTFSS	    TRMT
	    GOTO	    $-1
	    MOVLW	    0x24 ;SENDS THE DOLLAR HANDSHAKE
	    MOVWF	    TX1REG

	    BTFSS	    TRMT
	    GOTO	    $-1
	    MOVLW	    0x41 ;A
	    MOVWF	    TX1REG
	    BANKSEL	    PORTA
	    RETURN
	    
    ;REQUESTS THE CURRENT STATUS OF THE TARGET FOUND AT CURRENT_ADDRESS
    READ_TARGET_STATUS:
	    CALL	    I2CIDLE		;ENSURE THAT THE I2C LINES ARE IDLE
	    BANKSEL	    SSP1CON2
	    BSF		    SSP1CON2,0
	    BTFSC	    SSP1CON2,0		;WAIT UNTIL START CONDITION IS COMPLETE
	    GOTO	    $-1
	    BANKSEL	    PORTA
	    MOVF	    CURRENT_ADDRESS, W	;SEND I2C ADDRESS OUT 
	    ADDLW	    0X01		;CONVERT THE WRITE ADDRESS TO THE READ ADDRESS
	    BANKSEL	    SSP1BUF
	    MOVWF	    SSP1BUF
	    BANKSEL	    SSP1STAT
	    BTFSC	    SSP1STAT,0		;WAIT UNTIL ALL DATA HAS BEEN SHIFTED OUT OF SSPBUF
	    GOTO	    $-1
	    CALL	    I2CIDLE		;ENSURE THAT THE I2C LINES ARE IDLE
	    BANKSEL	    SSP1CON2
	    BTFSC	    SSP1CON2,6		;DETERMINE IF THERE IS AN ACK FROM THE SLAVE
	    GOTO	    BAD1
	    BSF		    SSP1CON2,3		;ENABLE RCEN TO RECEIVE DATA FROM THE SLAVE
	    BANKSEL	    SSP1STAT
	    BTFSS	    SSP1STAT,0		;WAIT UNTIL ALL DATA HAS BEEN SHIFTED INTO SSPBUF FROM THE SLAVE
	    GOTO	    $-1
	    BANKSEL	    SSP1BUF
	    MOVFW	    SSP1BUF		;\\READ STATUS OF CURRENT TARGET
	    BANKSEL	    PORTA		;//STORE BYTE INTO RECEIVED_BYTE REGISTER
	    MOVWF	    RECEIVED_BYTE	;/
	    BANKSEL	    SSP1CON2
	    BSF		    SSP1CON2,2		;CREATE STOP CONDITION
	    BTFSC	    SSP1CON2,2
	    GOTO	    $-1			;WAIT FOR STOP CONDITION TO COMPLETE
	    BCF		    SSP1CON2,3
	    CALL	    TEST_SCORE		;TEST TO SEE IF A PLAYER HAS SCORED
	    RETURN
	    
    ;TESTS THE SCORE BASED RECEIVED_BYTE
    TEST_SCORE:
	    BANKSEL	    TX1REG
	    BTFSS	    TRMT
	    GOTO	    $-1
	    MOVLW	    0x24 ;SENDS THE DOLLAR HANDSHAKE
	    MOVWF	    TX1REG

	    BTFSS	    TRMT
	    GOTO	    $-1
	    MOVLW	    0x52 ;R
	    MOVWF	    TX1REG
	    
	    BANKSEL	    PORTA
	    MOVF	    RECEIVED_BYTE, W
	    BANKSEL	    TX1REG
	    BTFSS	    TRMT
	    GOTO	    $-1
	    MOVWF	    TX1REG
	    RETURN				;NEITHER PLAYER SCORED, RETURN

    ;VERIFIES THAT THE I2C LINES ARE IDLE
    I2CIDLE:	
	    MOVLW	    0X1F		;Load Bus Test Value
	    BANKSEL	    SSP1CON2		
	    ANDWF	    SSP1CON2,W		;Compare 1F to check for 5 busy conditions
	    BANKSEL	    STATUS
	    BTFSS	    STATUS,2		;Test Zero Bit STATUS,Z
	    GOTO	    I2CIDLE		;Z=0  Bus is still busy -repeat
	CHECKR_W:				;Z=1 Not Busy
	    BANKSEL	    SSP1STAT
	    BTFSC	    SSP1STAT,2		;see if SSP is transmitting data
	    GOTO	    CHECKR_W		;R_W = 1 - Still transmitting data
	    RETURN				;R_W = 0 - Transmit done

    ;BAD I2C STATE, GENERATES A STOP CONDITION
    BAD1:	
	    BANKSEL	    SSP1CON2
	    BSF		    SSP1CON2,2		;CREATE STOP CONDITION
	    BTFSC	    SSP1CON2,2
	    GOTO	    $-1			;WAIT FOR STOP CONDITION TO COMPLETE
	    
	    BANKSEL	    TX1REG
	    BTFSS	    TRMT
	    GOTO	    $-1
	    MOVLW	    0x24 ;SENDS THE DOLLAR HANDSHAKE
	    MOVWF	    TX1REG

	    BTFSS	    TRMT
	    GOTO	    $-1
	    MOVLW	    0x46 ;F FOR FAIL
	    MOVWF	    TX1REG
	    
	    RETURN
	    
    ;WHEN UART IS RECEIVED, DETERMINES IF IT IS THE CORRECT DEVICE AND HOW TO RESPOND
    UARTRX:
	    BANKSEL	    PIE1
	    BCF		    RCIE		;DISABLES INTERRUPTS FROM RECEIVING DATA
	    BANKSEL	    PORTA
	    BTFSC	    UART_MODE, 7	;IF HANDSHAKE ALREADY RECEIVED, GOTO INTERPRETCOMMAND
	    GOTO	    INTERPRETUART
	    BANKSEL	    RC1REG		;ELSE CHECK RECEIVED BYTE FOR HANDSHAKE
	    MOVF	    RC1REG, 0
	    XORLW	    0X24		;COMPARE RECEIVED BYTE WITH $
	    BANKSEL	    PORTA
	    BTFSC	    STATUS,2		;IF RECEIVED MATCHES $, SET HNDSK FLAG IN UART_RX_MODE STATUS,Z
	    BSF		    UART_MODE, 7
	    GOTO	    ENABLE_RECEIVE_INT
	    
	;THE HANDSHAKE BYTE WAS RECEIVED PREVIOUSLY, CHECK THE NEW BYTE FOR THE COMMAND TO EXECUTE
	INTERPRETUART:
	    BANKSEL	    PORTA
	    BCF		    UART_MODE, 7	;CLEAR THE HNDSK FLAG
	    BANKSEL	    RC1REG
	    MOVF	    RC1REG, W
	    MOVWF	    UART_RX_BYTE	;STORE RECEIVED BYTE IN UART_RX_BYTE
	    XORLW	    0X56
	    BTFSC	    STATUS,2		;IF RECEIVED BYTE IS DEVICE VERIFICATION COMMAND, GOTO DEVICEVERIFICATION STATUS, Z
	    GOTO	    DEVICEVERIFICATION
	    
	    MOVF	    UART_RX_BYTE, W	
	    XORLW	    0X57
	    BTFSC	    STATUS,2		;IF RECEIVED BYTE IS Write I2C, GOTO GET_I2C_WRITE_DATA
	    GOTO	    GET_I2C_WRITE_DATA
	    
	    MOVF	    UART_RX_BYTE, W	
	    XORLW	    0X52
	    BTFSC	    STATUS,2		;IF RECEIVED BYTE IS Read I2C, GOTO GET_I2C_READ_DATA
	    GOTO	    GET_I2C_READ_DATA
	    
	    MOVF	    UART_RX_BYTE, W	
	    XORLW	    0X43
	    BTFSC	    STATUS,2		;IF RECEIVED BYTE IS Update Player Color, GOTO UPDATE_PLAYER_COLOR
	    GOTO	    UPDATE_PLAYER_COLOR ;STIL NEED TO DO
	    
	    BANKSEL	    TX1REG
	    BTFSS	    TRMT
	    GOTO	    $-1
	    MOVLW	    0x24 ;SENDS THE DOLLAR HANDSHAKE
	    MOVWF	    TX1REG
	    
	    BTFSS	    TRMT
	    GOTO	    $-1
	    MOVLW	    0x55 ;U FOR UNABLE TO PERFORM COMMAND
	    MOVWF	    TX1REG
	    
	    GOTO	    ENABLE_RECEIVE_INT
	    
	    ;THE DEVICE VERIFICATION COMMAND WAS RECEIVED, RESPOND WITH HANDSHAKE BYTE AND FIRST BYTE OF VERIFICATION
	    DEVICEVERIFICATION:
		BANKSEL	    TX1REG
		BTFSS	    TRMT
		GOTO	    $-1
		MOVLW	    0x24 ;SENDS THE DOLLAR HANDSHAKE
		MOVWF	    TX1REG
    
		BTFSS	    TRMT
		GOTO	    $-1
		MOVLW	    0x4C		;TRANSMIT SECOND BYTE OF DEVICE VERIFICATION
		MOVWF	    TX1REG

		BTFSS	    TRMT
		GOTO	    $-1
		MOVLW	    0x41		;TRANSMIT SECOND BYTE OF DEVICE VERIFICATION
		MOVWF	    TX1REG
		
		BTFSS	    TRMT
		GOTO	    $-1
		MOVLW	    0x4D		;TRANSMIT SECOND BYTE OF DEVICE VERIFICATION
		MOVWF	    TX1REG	
		GOTO	    ENABLE_RECEIVE_INT
    
	    ;THE DEVICE VERIFICATION COMMAND WAS RECEIVED, RESPOND WITH HANDSHAKE BYTE AND FIRST BYTE OF VERIFICATION
	    GET_I2C_WRITE_DATA:
		CALL	    RECEIVE_BYTE
		BANKSEL	    PORTA
		MOVWF	    CURRENT_ADDRESS	;STORES THE ADDRESS IN A REGISTER TO SEND OUT LATER
		
		CALL	    RECEIVE_BYTE
		BANKSEL	    PORTA
		MOVWF	    WRITE_DATA		;STORES THE DATA IN A REGISTER TO SEND OUT LATER
		
		CALL	    WRITE_I2C
		GOTO	    ENABLE_RECEIVE_INT
		
	    ;THE DEVICE VERIFICATION COMMAND WAS RECEIVED, RESPOND WITH HANDSHAKE BYTE AND FIRST BYTE OF VERIFICATION
	    GET_I2C_READ_DATA:
		CALL	    RECEIVE_BYTE
		BANKSEL	    PORTA
		MOVWF	    CURRENT_ADDRESS	;STORES THE ADDRESS IN A REGISTER TO SEND OUT LATER
		CALL	    READ_TARGET_STATUS ;
		GOTO	    ENABLE_RECEIVE_INT
			
	    ;THE DEVICE VERIFICATION COMMAND WAS RECEIVED, RESPOND WITH HANDSHAKE BYTE AND FIRST BYTE OF VERIFICATION
	    UPDATE_PLAYER_COLOR:
		CALL	    RECEIVE_BYTE
		BANKSEL	    PORTA
		MOVWF	    PLAYER_NUMBER	;STORES THE ADDRESS IN A REGISTER TO SEND OUT LATER
		
		CALL	    RECEIVE_BYTE
		BANKSEL	    PORTA
		MOVWF	    GREEN		;STORES THE DATA IN A REGISTER TO SEND OUT LATER
		
		CALL	    RECEIVE_BYTE
		BANKSEL	    PORTA
		MOVWF	    RED			;STORES THE DATA IN A REGISTER TO SEND OUT LATER
		
		CALL	    RECEIVE_BYTE
		BANKSEL	    PORTA
		MOVWF	    BLUE		;STORES THE DATA IN A REGISTER TO SEND OUT LATER
		
		CALL	    WRITE_COLOR_I2C
		GOTO	    ENABLE_RECEIVE_INT
		
	    ;THE DEVICE VERIFICATION COMMAND WAS RECEIVED, RESPOND WITH HANDSHAKE BYTE AND FIRST BYTE OF VERIFICATION
	    RECEIVE_BYTE:
		BANKSEL	    T2CON
		BSF	    T2CON, 2			;START TIMEOUT TIMER
		
		TIMELOOP:
		BANKSEL	    PORTA
		BTFSC	    DID_TIME_OUT, 0		;A TMR2 INTERRUPT SETS THIS BIT WHEN TIMED OUT
		GOTO	    EXIT_LOOP			;PREVENTS GETTING LOOPED LOCKED
		BANKSEL	    PIR1
		BTFSS	    RCIF			;FINISHED RECEIVING?
		GOTO	    TIMELOOP			;NO
		
		EXIT_LOOP:
    		BANKSEL	    T2CON
		MOVLW	    0x7B			;STOPS TIMER
		BANKSEL	    PR2
		MOVLW	    0XFF			;MAXIMUM TIME FOR TMR2
		BANKSEL	    TMR2
		CLRF	    TMR2			;STARTS TMR2 AT 0
		
		BANKSEL	    RC1REG
		MOVF	    RC1REG, W			;MOVES THE RECEIVED BYTE INTO W
		RETURN

	    TIMEDOUT:
		BANKSEL	    PORTA
		BSF	    DID_TIME_OUT, 0
		BANKSEL	    T2CON
		MOVLW	    0x7B			;01111011 CONFIGURES THE MAXIMUM TIME FOR TMR2
		BANKSEL	    PR2
		MOVLW	    0XFF			;MAXIMUM TIME FOR TMR2
		BANKSEL	    TMR2
		CLRF	    TMR2			;STARTS TMR2 AT 0
		RETURN
		
	    ENABLE_RECEIVE_INT:
		BANKSEL	    PIE1
		BSF	    RCIE		;REENABLES INTERRUPTS FROM RECEIVING DATA
		RETURN