;************************************************************************************
;										    *
;   Filename:	    MASTER_SUBROUTINES.inc					    *
;   Date:	    April 22, 2025						    *
;   File Version:   2								    *
;   Author:	    Alex Wheelock and Andrew Keller				    *
;   Company:	    Idaho State University					    *
;   Description:    Contains all subroutines needed for the Laser Shooting Game     *
;		    project. Subroutines include the ability to communicate via	    *
;		    UART for control, I2C write/read, and updating each target	    *
;		    slot for I2C enabling, disabling or polling.		    *
;										    *
;************************************************************************************

;************************************************************************************
;										    *
;   Revision History:								    *
;										    *
;   1:	Initialize file, get everything working the way that I thought it should    *
;	work.									    *
;   2:	Update to include UART and I2C for up to eight different targets active     *
;	simultaneously.								    *
;										    *
;************************************************************************************		
	    
SUBROUTINES_CODE CODE
  
    ;WRITES THE DATA STORED IN WRITE_DATA TO THE I2C ADDRESS IN CURRENT_ADDRESS
    WRITE_I2C:
	    CALL	    I2CIDLE		;ENSURE THAT THE I2C LINES ARE IDLE
	    BANKSEL	    SSPCON2
	    BSF		    SSPCON2,0
	    BTFSC	    SSPCON2,0		;WAIT UNTIL START CONDITION IS COMPLETE
	    GOTO	    $-1
	    BANKSEL	    PORTA
	    MOVF	    CURRENT_ADDRESS, W	;SEND I2C ADDRESS OUT 
	    BANKSEL	    SSPBUF
	    MOVWF	    SSPBUF
	    BANKSEL	    SSPSTAT
	    BTFSC	    SSPSTAT,0		;WAIT UNTIL ALL DATA HAS BEEN SHIFTED OUT OF SSPBUF
	    GOTO	    $-1
	    CALL	    I2CIDLE		;ENSURE THAT THE I2C LINES ARE IDLE
	    BANKSEL	    SSPCON2
	    BTFSC	    SSPCON2,6		;DETERMINE IF THERE IS AN ACK FROM THE SLAVE
	    GOTO	    BAD1		;NACK FROM THE SLAVE, STOP COMMUNICATION
	    BANKSEL	    PORTA
	    MOVF	    WRITE_DATA, W
	    BANKSEL	    SSPBUF
	    MOVWF	    SSPBUF		;TRANSMIT DATA TO SLAVE
	    BANKSEL	    SSPSTAT
	    BTFSC	    SSPSTAT,0		;WAIT UNTIL ALL DATA HAS BEEN SHIFTED OUT OF SSPBUF
	    GOTO	    $-1
	    CALL	    I2CIDLE		;ENSURE THAT THE I2C LINES ARE IDLE
	    BANKSEL	    SSPCON2
	    BTFSC	    SSPCON2,6		;DETERMINE IF THERE IS AN ACK FROM THE SLAVE
	    GOTO	    BAD1		;NACK FROM THE SLAVE, STOP COMMUNICATION
	    BSF		    SSPCON2,2		;CREATE STOP CONDITION
	    BTFSC	    SSPCON2,2
	    GOTO	    $-1			;WAIT FOR STOP CONDITION TO COMPLETE
	    BANKSEL	    PORTA
	    RETURN
	    
    ;REQUESTS THE CURRENT STATUS OF THE TARGET FOUND AT CURRENT_ADDRESS
    READ_TARGET_STATUS:
	    CALL	    I2CIDLE		;ENSURE THAT THE I2C LINES ARE IDLE
	    BANKSEL	    SSP1CON2
	    BSF		    SSP1CON2,0
	    BTFSC	    SSP1CON2,0		;WAIT UNTIL START CONDITION IS COMPLETE
	    GOTO	    $-1
	    BANKSEL	    PORTA
	    MOVF	    CURRENT_ADDRESS, W	;SEND I2C ADDRESS OUT 
	    ADDLW	    0X01		;CONVERT THE WRITE ADDRESS TO THE READ ADDRESS
	    BANKSEL	    SSP1BUF
	    MOVWF	    SSP1BUF
	    BANKSEL	    SSP1STAT
	    BTFSC	    SSP1STAT,0		;WAIT UNTIL ALL DATA HAS BEEN SHIFTED OUT OF SSPBUF
	    GOTO	    $-1
	    CALL	    I2CIDLE		;ENSURE THAT THE I2C LINES ARE IDLE
	    BANKSEL	    SSP1CON2
	    BTFSC	    SSP1CON2,6		;DETERMINE IF THERE IS AN ACK FROM THE SLAVE
	    GOTO	    BAD1
	    BSF		    SSP1CON2,3		;ENABLE RCEN TO RECEIVE DATA FROM THE SLAVE
	    BANKSEL	    SSP1STAT
	    BTFSS	    SSP1STAT,0		;WAIT UNTIL ALL DATA HAS BEEN SHIFTED INTO SSPBUF FROM THE SLAVE
	    GOTO	    $-1
	    BANKSEL	    SSP1BUF		;\
	    MOVFW	    SSP1BUF		;\\READ STATUS OF CURRENT TARGET
	    BANKSEL	    PORTA		;//STORE BYTE INTO RECEIVED_BYTE REGISTER
	    MOVWF	    RECEIVED_BYTE	;/
	    BANKSEL	    SSP1CON2
	    BSF		    SSP1CON2,2		;CREATE STOP CONDITION
	    BTFSC	    SSP1CON2,2
	    GOTO	    $-1			;WAIT FOR STOP CONDITION TO COMPLETE
	    CALL	    TEST_SCORE		;TEST TO SEE IF A PLAYER HAS SCORED
	    RETURN
	    
    ;TESTS THE SCORE BASED RECEIVED_BYTE
    TEST_SCORE:
	    ;PLAYER1 = 0x0F
	    ;PLAYER2 = 0xF0
	    ;NO SCORE = 0x00
	    BANKSEL	    PORTA
	    BTFSC	    RECEIVED_BYTE,3	;DETERMINE IF PLAYER 1 SCORED
	    GOTO	    PLAYER1_SCORED
	    BTFSC	    RECEIVED_BYTE,7	;DETERMINE IF PLAYER 2 SCORED
	    GOTO	    PLAYER2_SCORED
	    RETURN				;NEITHER PLAYER SCORED, RETURN
	PLAYER1_SCORED
	    MOVLW	    0x01
	    MOVWF	    SCORE_PLAYER	;MOVE PLAYERONE INTO SCORE_PLAYER
	    MOVFW	    CURRENT_ADDRESS
	    MOVWF	    SCORE_ADDRESS	;MOVE THE CURRENT I2C ADDRESS INTO THE SCORE_ADDRESS
	    CALL	    UARTSENDSCORE	;CALL THE UARTSENDSCORE SUBROUTINE
	    RETLW	    0xFF		;RETURN WITH 0XFF IN W TO MARK A SCORE WAS DETECTED
	PLAYER2_SCORED
	    MOVLW	    0x02
	    MOVWF	    SCORE_PLAYER	;MOVE PLAYERTWO INTO SCORE_PLAYER
	    MOVFW	    CURRENT_ADDRESS
	    MOVWF	    SCORE_ADDRESS	;MOVE THE CURRENT I2C ADDRESS INTO THE SCORE_ADDRESS
	    CALL	    UARTSENDSCORE
	    RETLW	    0xFF
	    
    ;VERIFIES THAT THE I2C LINES ARE IDLE
    I2CIDLE:	
	    MOVLW	    0X1F		;Load Bus Test Value
	    BANKSEL	    SSP1CON2		
	    ANDWF	    SSP1CON2,W		;Compare 1F to check for 5 busy conditions
	    BANKSEL	    STATUS
	    BTFSS	    STATUS,Z		;Test Zero Bit
	    GOTO	    I2CIDLE		;Z=0  Bus is still busy -repeat
	CHECKR_W				;Z=1 Not Busy
	    BANKSEL	    SSP1STAT
	    BTFSC	    SSP1STAT,2		;see if SSP is transmitting data
	    GOTO	    CHECKR_W		;R_W = 1 - Still transmitting data
	    RETURN				;R_W = 0 - Transmit done

    ;BAD I2C STATE, GENERATES A STOP CONDITION
    BAD1:	
	    MOVLW	    0XFF		;SET RETURN CODE TO -1
	    BANKSEL	    SSP1CON2
	    BSF		    SSP1CON2,PEN	;GENERATE A STOP CONDITION
	LOOP5
	    BTFSC	    SSP1CON2,PEN	;IS STOP CONDITION DONE
	    GOTO	    LOOP5
	    RETURN
	    
    ;WHEN UART IS RECEIVED, DETERMINES IF IT IS THE CORRECT DEVICE AND HOW TO RESPOND
    UARTRX:
	    BANKSEL	    PORTA
	    BTFSC	    UART_MODE, 4	;IF ENABLE COMMAND ALREADY RECEIVED, GOTO ENABLECOMMAND
	    GOTO	    ENABLECOMMAND
	    BTFSC	    UART_MODE, 3	;IF DISABLE COMMAND ALREADY RECEIVED, GOTO DISABLECOMMAND
	    GOTO	    DISABLECOMMAND
	    BTFSC	    UART_MODE, 2	;IF CHANGE COMMAND ALREADY RECEIVED, GOTO STORECHANGESLOT
	    GOTO	    STORECHANGESLOT
	    BTFSC	    UART_MODE, 1	;IF CHANGE SLOT ALREADY RECEIVED, GOTO CHANGESLOTADDRESS
	    GOTO	    CHANGESLOTADDRESS
	    BTFSC	    UART_MODE, 7	;IF HANDSHAKE ALREADY RECEIVED, GOTO INTERPRETCOMMAND
	    GOTO	    INTERPRETUART
	    BANKSEL	    RCREG		;ELSE CHECK RECEIVED BYTE FOR HANDSHAKE
	    MOVF	    RCREG, W
	    XORLW	    0X24		;COMPARE RECEIVED BYTE WITH $
	    BANKSEL	    PORTA
	    BTFSC	    STATUS, Z		;IF RECEIVED MATCHES $, SET HNDSK FLAG IN UART_RX_MODE
	    BSF		    UART_MODE, 7
	    RETURN
	    
	;THE HANDSHAKE BYTE WAS RECEIVED PREVIOUSLY, CHECK THE NEW BYTE FOR THE COMMAND TO EXECUTE
	INTERPRETUART
	    BANKSEL	    PORTA
	    BCF		    UART_MODE, 7	;CLEAR THE HNDSK FLAG
	    BANKSEL	    RCREG
	    MOVF	    RCREG, W
	    BANKSEL	    PORTA
	    MOVWF	    UART_RX_BYTE	;STORE RECEIVED BYTE IN UART_RX_BYTE
	    XORLW	    0X56
	    BTFSC	    STATUS, Z		;IF RECEIVED BYTE IS DEVICE VERIFICATION COMMAND, GOTO DEVICEVERIFICATION
	    GOTO	    DEVICEVERIFICATION
	    MOVF	    UART_RX_BYTE, W	
	    XORLW	    0X45
	    BTFSC	    STATUS, Z		;IF RECEIVED BYTE IS ENABLE COMMAND, SET ENABLE FLAG FOR NEXT RECEIVE BYTE
	    BSF		    UART_MODE, 4
	    MOVF	    UART_RX_BYTE, W
	    XORLW	    0X44
	    BTFSC	    STATUS, Z		;IF RECEIVED BYTE IS DISABLE COMMAND, SET DISABLE FLAG FOR NEXT RECEIVE BYTE
	    BSF		    UART_MODE, 3
	    MOVF	    UART_RX_BYTE, W
	    XORLW	    0X43
	    BTFSC	    STATUS, Z		;IF RECEIVED BYTE IS CLEAR COMMAND, GOTO CLEAR TARGETS
	    GOTO	    CLEARTARGETS
	    MOVF	    UART_RX_BYTE, W
	    XORLW	    0X41
	    BTFSC	    STATUS, Z		;IF RECEIVED BYTE IS CHANGE TARGET COMMAND, SET CHANGE FLAG FOR NEXT RECEIVE BYTE
	    BSF		    UART_MODE, 2
	    RETURN
	    
	;THE DEVICE VERIFICATION COMMAND WAS RECEIVED, RESPOND WITH HANDSHAKE BYTE AND FIRST BYTE OF VERIFICATION
	DEVICEVERIFICATION
	    BANKSEL	    TXREG
	    MOVLW	    0X24
	    MOVWF	    TXREG		;TRANSMIT HANDSHAKE BYTE
	    MOVLW	    0X4C
	    MOVWF	    TXREG		;TRANSMIT FIRST HALF OF DEVICE VERIFICATION
	    BANKSEL	    PORTA
	    BSF		    UART_MODE, 6	;SET THE VERIFY FLAG FOR NEXT TX INTERRUPT
	    BANKSEL	    PIE1
	    BSF		    PIE1, TXIE		;ENABLE THE UART TRANSMIT INTERRUPT
	    RETURN
	    
	;THE ENABLE COMMAND WAS RECEIVED, INCLUSIVE OR THE THIRD RECEIVED BYTE WITH THE ENABLE_TARGET REGISTER
	ENABLECOMMAND
	    BANKSEL	    RCREG
	    MOVF	    RCREG, W		;RETRIEVE THE ENABLE BYTE
	    BANKSEL	    PORTA
	    IORWF	    ENABLE_TARGET, W	;OR THE ENABLE BYTE WITH THE ENABLE_TARGET REGISTER
	    MOVWF	    ENABLE_TARGET
	    BCF		    UART_MODE, 4	;CLEAR ENABLE FLAG
	    RETURN
	    
	;THE DISABLE COMMAND WAS RECEIVED, INCLUSIVE OR THE THIRD RECEIVED BYTE WITH THE DISABLE_TARGET REGISTER
	DISABLECOMMAND
	    BANKSEL	    RCREG
	    MOVF	    RCREG, W		;RETRIEVE THE DISABLE BYTE
	    BANKSEL	    PORTA
	    IORWF	    DISABLE_TARGET, f	;OR THE DISABLE BYTE WITH THE DISABLE_TARGET REGISTER
	    BCF		    UART_MODE, 3	;CLEAR DISABLE FLAG
	    RETURN
	    
	;THE CLEAR COMMAND WAS RECEIVED, MOVE A 0XFF INTO DISABLE_TARGET
	CLEARTARGETS
	    BANKSEL	    PORTA
	    MOVLW	    0XFF
	    MOVWF	    DISABLE_TARGET	;SET DISABLE FLAGS FOR ALL TARGETS
	    RETURN
	    
	;THE CHANGE SLOT ADDRESS COMMAND WAS RECEIVED, STORE THE THIRD BYTE RECEIVED IN THE CHANGE_SLOT REGISTER
	STORECHANGESLOT
	    BANKSEL	    RCREG
	    MOVF	    RCREG, W		;RETRIEVE THE CHANGE SLOT
	    BANKSEL	    PORTA
	    MOVWF	    CHANGE_SLOT		;STORE THE CHANGE SLOT
	    BCF		    UART_MODE, 2	;CLEAR CHANGE FLAG
	    BSF		    UART_MODE, 1	;SET SLOT FLAG
	    RETURN
	    
	;THE CHANGE SLOT ADDRESS COMMAND WAS RECEIVED, STORE THE FOURTH BYTE RECEIVED IN THE CORRESPONDING TARGET SLOT
	CHANGESLOTADDRESS
	    BANKSEL	    RCREG
	    MOVF	    RCREG, W		;RETRIEVE THE I2C ADDRESS
	    BANKSEL	    PORTA
	    BCF		    UART_MODE, 1	;CLEAR THE SLOT FLAG
	    BTFSC	    CHANGE_SLOT, 7	;GOTO CHANGETARGET ASSOCIATED WITH CHANGE SLOT BIT
	    GOTO	    CHANGETARGETONE
	    BTFSC	    CHANGE_SLOT, 6
	    GOTO	    CHANGETARGETTWO
	    BTFSC	    CHANGE_SLOT, 5
	    GOTO	    CHANGETARGETTHREE
	    BTFSC	    CHANGE_SLOT, 4
	    GOTO	    CHANGETARGETFOUR
	    BTFSC	    CHANGE_SLOT, 3
	    GOTO	    CHANGETARGETFIVE
	    BTFSC	    CHANGE_SLOT, 2
	    GOTO	    CHANGETARGETSIX
	    BTFSC	    CHANGE_SLOT, 1
	    GOTO	    CHANGETARGETSEVEN
	    BTFSC	    CHANGE_SLOT, 0
	    GOTO	    CHANGETARGETEIGHT
	    RETURN
	    
	CHANGETARGETONE
	    BTFSC	    INUSE_TARGET, 7	;IF THE TARGET IS CURRENTLY IN USE, RETURN
	    RETURN
	    BANKSEL	    PORTA
	    MOVWF	    TGT_ONE_ADDRESS	;ELSE UPDATE THE TARGET SLOT ADDRESS
	    RETURN
	    
	CHANGETARGETTWO
	    BTFSC	    INUSE_TARGET, 6	;IF THE TARGET IS CURRENTLY IN USE, RETURN
	    RETURN
	    BANKSEL	    PORTA
	    MOVWF	    TGT_TWO_ADDRESS	;ELSE UPDATE THE TARGET SLOT ADDRESS
	    RETURN
	    
	CHANGETARGETTHREE
	    BTFSC	    INUSE_TARGET, 5	;IF THE TARGET IS CURRENTLY IN USE, RETURN
	    RETURN
	    BANKSEL	    PORTA
	    MOVWF	    TGT_THREE_ADDRESS	;ELSE UPDATE THE TARGET SLOT ADDRESS
	    RETURN
	    
	CHANGETARGETFOUR
	    BTFSC	    INUSE_TARGET, 4	;IF THE TARGET IS CURRENTLY IN USE, RETURN
	    RETURN
	    BANKSEL	    PORTA
	    MOVWF	    TGT_FOUR_ADDRESS	;ELSE UPDATE THE TARGET SLOT ADDRESS
	    RETURN
	    
	CHANGETARGETFIVE
	    BTFSC	    INUSE_TARGET, 3	;IF THE TARGET IS CURRENTLY IN USE, RETURN
	    RETURN
	    BANKSEL	    PORTA
	    MOVWF	    TGT_FIVE_ADDRESS	;ELSE UPDATE THE TARGET SLOT ADDRESS
	    RETURN
	    
	CHANGETARGETSIX
	    BTFSC	    INUSE_TARGET, 2	;IF THE TARGET IS CURRENTLY IN USE, RETURN
	    RETURN
	    BANKSEL	    PORTA
	    MOVWF	    TGT_SIX_ADDRESS	;ELSE UPDATE THE TARGET SLOT ADDRESS
	    RETURN
	    
	CHANGETARGETSEVEN
	    BTFSC	    INUSE_TARGET, 1	;IF THE TARGET IS CURRENTLY IN USE, RETURN
	    RETURN
	    BANKSEL	    PORTA
	    MOVWF	    TGT_SEVEN_ADDRESS	;ELSE UPDATE THE TARGET SLOT ADDRESS
	    RETURN
	    
	CHANGETARGETEIGHT
	    BTFSC	    INUSE_TARGET, 0	;IF THE TARGET IS CURRENTLY IN USE, RETURN
	    RETURN
	    BANKSEL	    PORTA
	    MOVWF	    TGT_EIGHT_ADDRESS	;ELSE UPDATE THE TARGET SLOT ADDRESS
	    RETURN
	   
    ;THE UART TX INTERRUPT HAS OCCURED, IF THE VERIFY FLAG IS SET, SEND THE LAST BYTE OF THE VERIFY COMMAND
    ;IF THE PLAYER FLAG IS SET, SEND THE SCORING PLAYER NUMBER
    UARTTX:
	    BANKSEL	    PIE1
	    BCF		    PIE1, TXIE		;DISABLE UART TX INTERRUPT
	    BTFSC	    PIE1, TXIE
	    GOTO	    $-2
	    BANKSEL	    PORTA
	    BTFSC	    UART_MODE, 6	;IF THE VERIFY FLAG IS SET, GOTO TXVERIFY
	    GOTO	    TXVERIFY
	    BTFSC	    UART_MODE, 5	;IF THE PLAYER FLAG IS SET, GOTO TXVERIFY
	    GOTO	    TXPLAYER
	    RETURN    
	TXVERIFY
	    BANKSEL	    TXREG
	    MOVLW	    0X41
	    MOVWF	    TXREG		;TRANSMIT THE SECOND HALF OF DEVICE VERIFICATION
	    BANKSEL	    PORTA
	    BCF		    UART_MODE, 6	;CLEAR THE VERIFY FLAG
	    RETURN
	TXPLAYER
	    BANKSEL	    PORTA
	    BCF		    UART_MODE, 5	;CLEAR PLAYER FLAG
	    MOVF	    SCORE_PLAYER, W
	    BANKSEL	    TXREG
	    MOVWF	    TXREG		;TRANSMIT THE SCORING PLAYER NUMBER
	    RETURN
	    
    ;A PLAYER HAS SCORED, SEND THE HANDSHAKE BYTE AND I2C ADDRESS OF THE SCORED TARGET VIA UART. SET THE PLAYER FLAG FOR THE TX INTERRUPT
    UARTSENDSCORE:
	    BANKSEL	    TXREG
	    MOVLW	    0X24
	    MOVWF	    TXREG		;TRANSMIT HANDSHAKE BYTE
	    BANKSEL	    PORTA
	    MOVF	    SCORE_ADDRESS, W
	    BANKSEL	    TXREG
	    MOVWF	    TXREG		;TRANSMIT I2C ADDRESS OF SCORED TARGET
	    BANKSEL	    PORTA
	    BSF		    UART_MODE, 5	;SET THE PLAYER FLAG FOR NEXT TX INTERRUPT
	    BANKSEL	    PIE1
	    BSF		    PIE1, TXIE		;ENABLE THE UART TRANSMIT INTERRUPT
	    RETURN
	    
	    
    ;CALLED IN MAIN TO EITHER ENABLE, DISABLE, OR POLL TARGET SLOT ONE
    UPDATETARGETONE:
	    BANKSEL	    PORTA		
	    MOVFW	    TGT_ONE_ADDRESS	;MOVE AN ADDRESS TO THE CURRENT_ADDRESS REGISTER
	    MOVWF	    CURRENT_ADDRESS
	    BTFSC	    ENABLE_TARGET, 7	;IF THE TARGET IS REQUESTED TO BE ENABLED, SEND THE ENABLE COMMAND
	    GOTO	    ENABLETARGETONE
	    BTFSC	    DISABLE_TARGET, 7	;IF THE TARGET IS REQUESTED TO BE DISABLED, SEND THE DISABLE COMMAND
	    GOTO	    DISABLETARGETONE
	    BTFSC	    INUSE_TARGET, 7	;IF THE TARGET IS CURRENTLY IN USE, POLL THE TARGET
	    GOTO	    POLLTARGETONE
	    RETURN
	ENABLETARGETONE
	    BANKSEL	    PORTA
	    MOVLW	    0X45		;MOVE AN ENABLE TO THE WRITE_DATA REGISTER
	    MOVWF	    WRITE_DATA
	    CALL	    WRITE_I2C		;CALL THE WRITE_I2C SUBROUTINE TO ENABLE THE TARGET
	    BANKSEL	    PORTA
	    BCF		    ENABLE_TARGET, 7	;CLEAR THE ENABLE TARGET FLAG
	    BSF		    INUSE_TARGET, 7	;MARK THE TARGET AS IN USE
	    RETURN
	DISABLETARGETONE
	    BANKSEL	    PORTA
	    MOVLW	    0X44		;MOVE A LETTER D TO THE WRITE_DATA REGISTER
	    MOVWF	    WRITE_DATA
	    CALL	    WRITE_I2C		;CALL THE WRITE_I2C SUBROUTINE TO ENABLE THE TARGET
	    BANKSEL	    PORTA
	    BCF		    DISABLE_TARGET, 7	;CLEAR THE DISABLE TARGET FLAG
	    BCF		    INUSE_TARGET, 7	;MARK THE TARGET AS NO LONGER IN USE
	    RETURN
	POLLTARGETONE
	    CALL	    READ_TARGET_STATUS	;ASK IF THE TARGET HAS BEEN SCORED ON
	    XORLW	    0XFF		;IF THE TARGET HAD A SCORE, W RETURNED WITH 0XFF
	    BANKSEL	    PORTA
	    BTFSC	    STATUS, Z		;IF A SCORE WAS RECORDED, CLEAR THE INUSE TARGET FLAG
	    BCF		    INUSE_TARGET, 7	;TARGET AUTOMATICALLY DISABLED ITSELF
	    RETURN
	    
	    
    ;CALLED IN MAIN TO EITHER ENABLE, DISABLE, OR POLL TARGET SLOT TWO
    UPDATETARGETTWO:
	    BANKSEL	    PORTA		
	    MOVFW	    TGT_TWO_ADDRESS	;MOVE AN ADDRESS TO THE CURRENT_ADDRESS REGISTER
	    MOVWF	    CURRENT_ADDRESS
	    BTFSC	    ENABLE_TARGET, 6	;IF THE TARGET IS REQUESTED TO BE ENABLED, SEND THE ENABLE COMMAND
	    GOTO	    ENABLETARGETTWO
	    BTFSC	    DISABLE_TARGET, 6	;IF THE TARGET IS REQUESTED TO BE DISABLED, SEND THE DISABLE COMMAND
	    GOTO	    DISABLETARGETTWO
	    BTFSC	    INUSE_TARGET, 6	;IF THE TARGET IS CURRENTLY IN USE, POLL THE TARGET
	    GOTO	    POLLTARGETTWO
	    RETURN
	ENABLETARGETTWO
	    BANKSEL	    PORTA
	    MOVLW	    0X45		;MOVE AN ENABLE TO THE WRITE_DATA REGISTER
	    MOVWF	    WRITE_DATA
	    CALL	    WRITE_I2C		;CALL THE WRITE_I2C SUBROUTINE TO ENABLE THE TARGET
	    BANKSEL	    PORTA
	    BCF		    ENABLE_TARGET, 6	;CLEAR THE ENABLE TARGET FLAG
	    BSF		    INUSE_TARGET, 6	;MARK THE TARGET AS IN USE
	    RETURN
	DISABLETARGETTWO
	    BANKSEL	    PORTA
	    MOVLW	    0X44		;MOVE A LETTER D TO THE WRITE_DATA REGISTER
	    MOVWF	    WRITE_DATA
	    CALL	    WRITE_I2C		;CALL THE WRITE_I2C SUBROUTINE TO ENABLE THE TARGET
	    BANKSEL	    PORTA
	    BCF		    DISABLE_TARGET, 6	;CLEAR THE DISABLE TARGET FLAG
	    BCF		    INUSE_TARGET, 6	;MARK THE TARGET AS NO LONGER IN USE
	    RETURN
	POLLTARGETTWO
	    CALL	    READ_TARGET_STATUS	;ASK IF THE TARGET HAS BEEN SCORED ON
	    XORLW	    0XFF		;IF THE TARGET HAD A SCORE, W RETURNED WITH 0XFF
	    BANKSEL	    PORTA
	    BTFSC	    STATUS, Z		;IF A SCORE WAS RECORDED, CLEAR THE INUSE TARGET FLAG
	    BCF		    INUSE_TARGET, 6	;TARGET AUTOMATICALLY DISABLED ITSELF
	    RETURN
	    

		