;************************************************************************************
;										    *
;   Filename:	    BLASTER_SUBROUTINES.inc						    *
;   Date:	    November 5, 2024						    *
;   File Version:   2								    *
;   Author:	    Alex Wheelock						    *
;   Company:	    Idaho State University					    *
;   Description:    Contains all subroutines needed for the Laser Arcade project.   *
;		    Subroutines include the ability to swap between the two player  *
;		    PWM frequencies of 56kHz and 38kHz, and the ability to shoot in *
;		    three different modes (single-shot, burst, & continuous), to    *
;		    move a solenoid and shoot the laser with the press of a button. *
;										    *
;************************************************************************************

;************************************************************************************
;										    *
;   Revision History:								    *
;										    *
;   1:	  (NOV 2024) Got everything for the gun working the way that I think it     *
;	  should with base features.						    *
;										    *		
;   2:	  (APRIL 3, 2025) Added an audio board, and connected all of PORTA, and	    *
;	  RC7,6,1, & 0 as triggers for the audio board, only RA0 & RA1 are being    *
;	  used as triggers currently, RC7 toggles in MAIN to ensure the volume is   *
;	  maxed out.								    *
;										    *
;	  Code was also updated to work properly with the fire select switch that   *
;	  will be used in the final product.					    *
;										    *	
;************************************************************************************	
	    
SUBROUTINES_CODE CODE
  
    FIRE_CONTINUOUS
		BANKSEL	    PORTB
		BTFSS	    PORTB,0			;TEST IF THE TRIGGER IS BEING HELD DOWN
		GOTO	    STOP_FIRING			;TRIGGER IS NOT BEING HELD DOWN, STOP FIRING
		BCF	    PORTA,0			;ENABLE TRIGGER1 TO PLAY SOUND FROM THE AUDIO BOARD
		BANKSEL	    TRISC
		BTFSC	    TRISC,2			;TEST IF OUTPUT DRIVER FOR PWM IS SET OR NOT (FOR ALTERNATING BETWEEN SET/RESET)
		GOTO	    FIRE			;OUTPUT DRIVER WAS NOT ENABLED, ENABLE IT
		GOTO	    _RESET			;OUTPUT DRIVER WAS ENABLED, DISABLE IT
			
	FIRE
		BCF	    TRISC,2			;ENABLE OUTPUT DRIVER FOR PWM
		BANKSEL	    PORTC
		BSF	    PORTC,3			;ENERGIZE THE SOLENOID
		GOTO	    CONTINUOUS_CHECK_TIMER	;POLL TIMER 1 FOR TIMING
		
	_RESET ;SETS
		BSF	    TRISC,2			;DISABLE OUTPUT DRIVER FOR PWM
		BANKSEL	    PORTC
		BCF	    PORTC,3			;DE-ENERGIZE THE SOLENOID
		GOTO	    CONTINUOUS_CHECK_TIMER
	CONTINUOUS_CHECK_TIMER
		BCF	    PIR1,0			;CLEAR TMR1IF
	POLL_TMR1_CONTINUOUS
		BTFSS	    PIR1,0			;POLL TMR1IF UNTIL SET, THEN CONTINUE THE CYCLE
		GOTO	    POLL_TMR1_CONTINUOUS	;TMR1 NOT DONE
		GOTO	    FIRE_CONTINUOUS		;TMR1 DONE, REPEAT CYCLE
		
    STOP_FIRING
		BANKSEL	    TRISC	
		BTFSS	    TRISC,2			;DETERMINE IF PWM OUTPUT DRIVER IS ALREADY DISABLED
		BSF	    TRISC,2			;OUTPUT DRIVER NOT DISABLED, DISABLE OUTPUT DRIVER
		BANKSEL	    PORTC
		BCF	    PORTC,3			;NO MATTER WHAT, VERIFY THAT THE SOLENOID IS DE-ENERGIZED
		;BSF	    PORTA,0			;RESET TRIG0 OF THE AUDIO BOARD
		;BSF	    PORTA,1			;RESET TRIG1 OF THE AUDIO BOARD
		MOVLW	    0xFF			;\
		MOVWF	    PORTA			;\\ SET ALL TRIG PINS LOW
		MOVLW	    0xF1			;// ENSURE NO FALSE TRIGGERS
		MOVWF	    PORTC			;/
		GOTO	    GOBACK			;LEAVE ISR
 
    FIRE_SEMI
		BANKSEL	    IOCBF
		BTFSS	    IOCBF,0			;DETERMINE IF A TRIGGER PRESS WAS RECORDED
		GOTO	    GOBACK			;DO NOTHING IF NO TRIGGER PRESS
		BANKSEL	    PORTB
		BTFSS	    PORTB,0			;VERIFY THAT THE BUTTON WAS PRESSED, AND THAT THE INTERRUPT WAS NOT FROM A TRIGGER RELEASE
		GOTO	    STOP_FIRING			;TRIGGER WAS BEING RELEASED FOR THE INTERRUPT, CANCEL EVERYTHING
		BANKSEL	    PORTC
		BCF	    PORTA,0			;ENABLE TRIG0 TO PLAY AUDIO
		MOVLW	    0x2F			;\
		MOVWF	    AUDIO_DELAY			;\\
	LOOP1						;\\\
		CLRF	    AUDIO_DELAY2		;\\\\
	LOOP2						;||||RUN THROUGH A DELAY TO ENSURE THAT AUDIO IS PLAYED WHEN FIRING IN THE SEMI-AUTO FIRING MODE
		DECFSZ	    AUDIO_DELAY2		;////(------------------------------------------------------------------------------------)
		GOTO	    LOOP2			;/// (NOTE: THE AUDIO BOARD IF VERY SLOW AND AS A RESULT IT NEEDS EXTRA TIME TO GET GOING.)
		DECFSZ	    AUDIO_DELAY			;//  (      AS A RESULT OF CONSTANTLY TOGGLING IN SEMI-AUTO, IT CANNOT KEEP UP WITH THE   )
		GOTO	    LOOP1			;/   (      FIRING, WHEN THE BLASTER TRIGGER IS SPAMMED.				  )
		BANKSEL	    TRISC			;    (------------------------------------------------------------------------------------)
		BCF	    TRISC,2			;ENABLE OUTPUT DRIVER
		BANKSEL	    PORTC
		BSF	    PORTC,3			;ENERGIZE SOLENOID
		CLRF	    TMR1L			;/RESET TMR1 FOR FULL TIMING
		CLRF	    TMR1H			;\
		BCF	    PIR1,0			;CLEAR TMR1IF
	POLL_TMR1_SEMI	
		BTFSS	    PIR1,0			;POLL TMR1IF UNTIL COMPLETE
		GOTO	    POLL_TMR1_SEMI		;TMR1 NOT DONE
		BANKSEL	    PORTC
		BCF	    PORTC,3			;TMR1 DONE, DE-ENERGIZE SOLENOID
		GOTO	    STOP_FIRING			;STOP FIRING
				
    FIRE_BURST
		BANKSEL	    IOCBF
		BTFSS	    IOCBF,0			;DETERMINE IF A TRIGGER PRESS WAS RECORDED
		GOTO	    GOBACK			;DO NOTHING IF NO TRIGGER PRESS
		BANKSEL	    PORTB
		BTFSS	    PORTB,0			;VERIFY THAT THE BUTTON WAS PRESSED, AND THAT THE INTERRUPT WAS NOT FROM A TRIGGER RELEASE
		GOTO	    STOP_FIRING			;TRIGGER WAS BEING RELEASED FOR THE INTERRUPT, CANCEL EVERYTHING
		BANKSEL	    PORTC
		BCF	    PORTA,1			;ENABLE TRIGGER1 TO PLAY THE BURST AUDIO FROM THE AUDIO BOARD
		CLRF	    AUDIO_DELAY                 ;\
	LOOP_AUDIO_DELAY				;\\PLAY A SHORT DELAY TO KEEP THE BURST AUDIO RELATIVELY IN SYNC WITH THE SHOTS
		DECFSZ	    AUDIO_DELAY			;//
		GOTO	    LOOP_AUDIO_DELAY		;/
		BANKSEL	    TRISC
		BCF	    TRISC,2			;ENABLE OUTPUT DRIVER FOR PWM
		BANKSEL	    PORTC
		BSF	    PORTC,3			;ENERGIZE THE SOLENOID
		CLRF	    TMR1L			;\RESET TMR1 FOR FULL TIMING
		CLRF	    TMR1H			;/
		BCF	    PIR1,0			;CLEAR TMR1IF
	POLL_TMR1_BURST1
		BTFSS	    PIR1,0			;POLL TMR1
		GOTO	    POLL_TMR1_BURST1		;TMR1 NOT DONE
		BANKSEL	    TRISC		
		BSF	    TRISC,2			;TMR1 IS DONE, DISABLE PWM OUTPUT DRIVER FOR RESET
		BANKSEL	    PORTC
		BCF	    PORTC,3			;DE-ENERGIZE SOLENOID
		BCF	    PIR1,0			;CLEAR TMR1IF
	POLL_TMR1_BURST2
		BTFSS	    PIR1,0			;POLL TMR1
		GOTO	    POLL_TMR1_BURST2
		BANKSEL	    TRISC
		BCF	    TRISC,2			;ENABLE OUTPUT DRIVER FOR PWM (SECOND SHOT)
		BANKSEL	    PORTC
		BSF	    PORTC,3			;ENERGIZE THE SOLENOID
		BCF	    PIR1,0			;CLEAR TMR1IF
	POLL_TMR1_BURST3
		BTFSS	    PIR1,0			;POLL TMR1
		GOTO	    POLL_TMR1_BURST3
		BANKSEL	    TRISC
		BSF	    TRISC,2			;TMR1 IS DONE, DISABLE PWM OUTPUT DRIVER FOR RESET
		BANKSEL	    PORTC
		BCF	    PORTC,3			;DE-ENERGIZE SOLENOID
		BCF	    PIR1,0			;CLEAR TMR1IF
	POLL_TMR1_BURST4
		BTFSS	    PIR1,0			;POLL TMR1
		GOTO	    POLL_TMR1_BURST4
		BANKSEL	    TRISC
		BCF	    TRISC,2			;ENABLE OUTPUT DRIVER FOR PWM (THIRD/FINAL SHOT)
		BANKSEL	    PORTC
		BSF	    PORTC,3			;ENERGIZE THE SOLENOID
		BCF	    PIR1,0			;CLEAR TMR1IF
	POLL_TMR1_BURST5
		BTFSS	    PIR1,0			;POLL TMR1
		GOTO	    POLL_TMR1_BURST5	
		BCF	    PORTC,3			;DE-ENERGIZE SOLENOID	
		GOTO	    STOP_FIRING
		
    
    SET_38KHZ
		BANKSEL	    CCPR1L
		MOVLW	    0x19			;SET PW TIME FOR ~95% DUTY CYCLE FOR MAX BRIGHTNESS
		MOVWF	    CCPR1L		
		BANKSEL	    PR2				
		MOVLW	    0x19			;SET PR2 TO 25 FOR 38kHz PERIOD
		MOVWF	    PR2	
		BANKSEL	    TMR2
		CLRF	    TMR2			;RESET TMR2
		GOTO	    TEST_MODE
    SET_56KHZ
		BANKSEL	    CCPR1L
		MOVLW	    0x11			;SET PW TIME FOR ~95% DUTY CYCLE FOR MAX BRIGHTNESS
		MOVWF	    CCPR1L		
		BANKSEL	    PR2				
		MOVLW	    0x11			;SET PR2 TO 17 FOR 56kHz PERIOD
		MOVWF	    PR2	
		BANKSEL	    TMR2
		CLRF	    TMR2			;RESET TMR2
		GOTO	    TEST_MODE
		

    
    
		